## boards/shields/trackpoint-sofle/Kconfig.shield
```kconfig
# Copyright (c) 2020 Ryan Cross
# SPDX-License-Identifier: MIT

config SHIELD_TP_SOFLE_LEFT
	def_bool $(shields_list_contains,tp_sofle_left)

config SHIELD_TP_SOFLE_RIGHT
	def_bool $(shields_list_contains,tp_sofle_right)
```
